# file: FRW4_0_RTOS.ioc
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ADC1.Channel-0\#ChannelRegularConversion=ADC_CHANNEL_4
ADC1.ClockPrescaler=ADC_CLOCK_ASYNC_DIV2
ADC1.ContinuousConvMode=DISABLE
ADC1.EnableInjectedConversion=ENABLE
ADC1.ExternalTrigInjecConv=ADC_EXTERNALTRIGINJEC_T1_TRGO2
ADC1.InjNumberOfConversion=1
ADC1.InjectedChannel-1\#ChannelInjectedConversion=ADC_CHANNEL_4
ADC1.InjectedOffsetNumber-1\#ChannelInjectedConversion=ADC_OFFSET_NONE
ADC1.InjectedOffsetSaturation-1\#ChannelInjectedConversion=DISABLE
ADC1.InjectedOffsetSignedSaturation-1\#ChannelInjectedConversion=DISABLE
ADC1.InjectedRank-1\#ChannelInjectedConversion=1
ADC1.InjectedSamplingTime-1\#ChannelInjectedConversion=ADC_SAMPLETIME_64CYCLES_5
ADC1.NbrOfConversionFlag=1
ADC1.OffsetNumber-0\#ChannelRegularConversion=ADC_OFFSET_NONE
ADC1.OffsetSignedSaturation-0\#ChannelRegularConversion=DISABLE
ADC1.Rank-0\#ChannelRegularConversion=1
ADC1.SamplingTime-0\#ChannelRegularConversion=ADC_SAMPLETIME_387CYCLES_5
ADC1.master=1
ADC2.ClockPrescaler=ADC_CLOCK_ASYNC_DIV2
ADC2.ContinuousConvMode=DISABLE
ADC2.EnableInjectedConversion=ENABLE
ADC2.EnableRegularConversion=DISABLE
ADC2.ExternalTrigInjecConv=ADC_EXTERNALTRIGINJEC_T1_TRGO2
ADC2.InjNumberOfConversion=1
ADC2.InjectedChannel-2\#ChannelInjectedConversion=ADC_CHANNEL_3
ADC2.InjectedOffsetNumber-2\#ChannelInjectedConversion=ADC_OFFSET_NONE
ADC2.InjectedOffsetSaturation-2\#ChannelInjectedConversion=DISABLE
ADC2.InjectedOffsetSignedSaturation-2\#ChannelInjectedConversion=DISABLE
ADC2.InjectedRank-2\#ChannelInjectedConversion=1
ADC2.InjectedSamplingTime-2\#ChannelInjectedConversion=ADC_SAMPLETIME_64CYCLES_5
ADC3.ClockPrescaler=ADC_CLOCK_ASYNC_DIV2
ADC3.DiscontinuousConvMode=DISABLE
ADC3.EnableInjectedConversion=ENABLE
ADC3.EnableRegularConversion=DISABLE
ADC3.ExternalTrigInjecConv=ADC_EXTERNALTRIGINJEC_T1_TRGO2
ADC3.InjNumberOfConversion=1
ADC3.InjectedChannel-1\#ChannelInjectedConversion=ADC_CHANNEL_3
ADC3.InjectedOffsetNumber-1\#ChannelInjectedConversion=ADC_OFFSET_NONE
ADC3.InjectedOffsetSaturation-1\#ChannelInjectedConversion=DISABLE
ADC3.InjectedOffsetSignedSaturation-1\#ChannelInjectedConversion=DISABLE
ADC3.InjectedRank-1\#ChannelInjectedConversion=1
ADC3.InjectedSamplingTime-1\#ChannelInjectedConversion=ADC_SAMPLETIME_64CYCLES_5
CORTEX_M7.AccessPermission_S-Cortex_Memory_Protection_Unit_Region1_Settings_S=MPU_REGION_PRIV_RO
CORTEX_M7.AccessPermission_S-Cortex_Memory_Protection_Unit_Region2_Settings_S=MPU_REGION_FULL_ACCESS
CORTEX_M7.AccessPermission_S-Cortex_Memory_Protection_Unit_Region3_Settings_S=MPU_REGION_FULL_ACCESS
CORTEX_M7.BaseAddress_S-Cortex_Memory_Protection_Unit_Region1_Settings_S=0x08000000
CORTEX_M7.BaseAddress_S-Cortex_Memory_Protection_Unit_Region2_Settings_S=0x90000000
CORTEX_M7.BaseAddress_S-Cortex_Memory_Protection_Unit_Region3_Settings_S=0xC0000000
CORTEX_M7.CPU_DCache=Enabled
CORTEX_M7.CPU_ICache=Enabled
CORTEX_M7.DisableExec_S-Cortex_Memory_Protection_Unit_Region2_Settings_S=MPU_INSTRUCTION_ACCESS_DISABLE
CORTEX_M7.DisableExec_S-Cortex_Memory_Protection_Unit_Region3_Settings_S=MPU_INSTRUCTION_ACCESS_DISABLE
CORTEX_M7.Enable_S-Cortex_Memory_Protection_Unit_Region1_Settings_S=MPU_REGION_ENABLE
CORTEX_M7.Enable_S-Cortex_Memory_Protection_Unit_Region2_Settings_S=MPU_REGION_ENABLE
CORTEX_M7.Enable_S-Cortex_Memory_Protection_Unit_Region3_Settings_S=MPU_REGION_ENABLE
CORTEX_M7.IsBufferable_S-Cortex_Memory_Protection_Unit_Region3_Settings_S=MPU_ACCESS_NOT_BUFFERABLE
CORTEX_M7.IsCacheable_S-Cortex_Memory_Protection_Unit_Region1_Settings_S=MPU_ACCESS_CACHEABLE
CORTEX_M7.IsCacheable_S-Cortex_Memory_Protection_Unit_Region3_Settings_S=MPU_ACCESS_NOT_CACHEABLE
CORTEX_M7.IsShareable_S-Cortex_Memory_Protection_Unit_Region2_Settings_S=MPU_ACCESS_SHAREABLE
CORTEX_M7.Number_S-Cortex_Memory_Protection_Unit_Region2_Settings_S=MPU_REGION_NUMBER2
CORTEX_M7.Number_S-Cortex_Memory_Protection_Unit_Region3_Settings_S=MPU_REGION_NUMBER3
CORTEX_M7.Number_S-Cortex_Memory_Protection_Unit_Region4_Settings_S=MPU_REGION_NUMBER4
CORTEX_M7.Size_S-Cortex_Memory_Protection_Unit_Region1_Settings_S=MPU_REGION_SIZE_2MB
CORTEX_M7.Size_S-Cortex_Memory_Protection_Unit_Region2_Settings_S=MPU_REGION_SIZE_32MB
CORTEX_M7.Size_S-Cortex_Memory_Protection_Unit_Region3_Settings_S=MPU_REGION_SIZE_8MB
CORTEX_M7.TypeExtField_S-Cortex_Memory_Protection_Unit_Region1_Settings_S=MPU_TEX_LEVEL1
CORTEX_M7.TypeExtField_S-Cortex_Memory_Protection_Unit_Region2_Settings_S=MPU_TEX_LEVEL1
CORTEX_M7.TypeExtField_S-Cortex_Memory_Protection_Unit_Region3_Settings_S=MPU_TEX_LEVEL1
CORTEX_M7.default_mode_Activation=1
DMA2D.ColorMode=DMA2D_OUTPUT_ARGB8888
DMA2D.Mode=DMA2D_R2M
Dma.Request0=SPI3_RX
Dma.Request1=SPI3_TX
Dma.Request2=SPI2_RX
Dma.Request3=SPI2_TX
Dma.SPI2_RX.2.Direction=DMA_PERIPH_TO_MEMORY
Dma.SPI2_RX.2.EventEnable=DISABLE
Dma.SPI2_RX.2.FIFOMode=DMA_FIFOMODE_DISABLE
Dma.SPI2_RX.2.Instance=DMA1_Stream4
Dma.SPI2_RX.2.MemDataAlignment=DMA_MDATAALIGN_HALFWORD
Dma.SPI2_RX.2.MemInc=DMA_MINC_ENABLE
Dma.SPI2_RX.2.Mode=DMA_CIRCULAR
Dma.SPI2_RX.2.PeriphDataAlignment=DMA_PDATAALIGN_HALFWORD
Dma.SPI2_RX.2.PeriphInc=DMA_PINC_DISABLE
Dma.SPI2_RX.2.Polarity=HAL_DMAMUX_REQ_GEN_RISING
Dma.SPI2_RX.2.Priority=DMA_PRIORITY_LOW
Dma.SPI2_RX.2.RequestNumber=1
Dma.SPI2_RX.2.SignalID=NONE
Dma.SPI2_RX.2.SyncEnable=DISABLE
Dma.SPI2_RX.2.SyncPolarity=HAL_DMAMUX_SYNC_NO_EVENT
Dma.SPI2_RX.2.SyncRequestNumber=1
Dma.SPI2_RX.2.SyncSignalID=NONE
Dma.SPI2_TX.3.Direction=DMA_MEMORY_TO_PERIPH
Dma.SPI2_TX.3.EventEnable=DISABLE
Dma.SPI2_TX.3.FIFOMode=DMA_FIFOMODE_DISABLE
Dma.SPI2_TX.3.Instance=DMA1_Stream5
Dma.SPI2_TX.3.MemDataAlignment=DMA_MDATAALIGN_HALFWORD
Dma.SPI2_TX.3.MemInc=DMA_MINC_ENABLE
Dma.SPI2_TX.3.Mode=DMA_CIRCULAR
Dma.SPI2_TX.3.PeriphDataAlignment=DMA_PDATAALIGN_HALFWORD
Dma.SPI2_TX.3.PeriphInc=DMA_PINC_DISABLE
Dma.SPI2_TX.3.Polarity=HAL_DMAMUX_REQ_GEN_RISING
Dma.SPI2_TX.3.Priority=DMA_PRIORITY_LOW
Dma.SPI2_TX.3.RequestNumber=1
Dma.SPI2_TX.3.SignalID=NONE
Dma.SPI2_TX.3.SyncEnable=DISABLE
Dma.SPI2_TX.3.SyncPolarity=HAL_DMAMUX_SYNC_NO_EVENT
Dma.SPI2_TX.3.SyncRequestNumber=1
Dma.SPI2_TX.3.SyncSignalID=NONE
Dma.SPI3_RX.0.Direction=DMA_PERIPH_TO_MEMORY
Dma.SPI3_RX.0.EventEnable=DISABLE
Dma.SPI3_RX.0.FIFOMode=DMA_FIFOMODE_DISABLE
Dma.SPI3_RX.0.Instance=DMA1_Stream2
Dma.SPI3_RX.0.MemDataAlignment=DMA_MDATAALIGN_BYTE
Dma.SPI3_RX.0.MemInc=DMA_MINC_ENABLE
Dma.SPI3_RX.0.Mode=DMA_CIRCULAR
Dma.SPI3_RX.0.PeriphDataAlignment=DMA_PDATAALIGN_BYTE
Dma.SPI3_RX.0.PeriphInc=DMA_PINC_DISABLE
Dma.SPI3_RX.0.Polarity=HAL_DMAMUX_REQ_GEN_RISING
Dma.SPI3_RX.0.Priority=DMA_PRIORITY_LOW
Dma.SPI3_RX.0.RequestNumber=1
Dma.SPI3_RX.0.SignalID=NONE
Dma.SPI3_RX.0.SyncEnable=DISABLE
Dma.SPI3_RX.0.SyncPolarity=HAL_DMAMUX_SYNC_NO_EVENT
Dma.SPI3_RX.0.SyncRequestNumber=1
Dma.SPI3_RX.0.SyncSignalID=NONE
Dma.SPI3_TX.1.Direction=DMA_MEMORY_TO_PERIPH
Dma.SPI3_TX.1.EventEnable=DISABLE
Dma.SPI3_TX.1.FIFOMode=DMA_FIFOMODE_DISABLE
Dma.SPI3_TX.1.Instance=DMA1_Stream3
Dma.SPI3_TX.1.MemDataAlignment=DMA_MDATAALIGN_BYTE
Dma.SPI3_TX.1.MemInc=DMA_MINC_ENABLE
Dma.SPI3_TX.1.Mode=DMA_CIRCULAR
Dma.SPI3_TX.1.PeriphDataAlignment=DMA_PDATAALIGN_BYTE
Dma.SPI3_TX.1.PeriphInc=DMA_PINC_DISABLE
Dma.SPI3_TX.1.Polarity=HAL_DMAMUX_REQ_GEN_RISING
Dma.SPI3_TX.1.Priority=DMA_PRIORITY_LOW
Dma.SPI3_TX.1.RequestNumber=1
Dma.SPI3_TX.1.SignalID=NONE
Dma.SPI3_TX.1.SyncEnable=DISABLE
Dma.SPI3_TX.1.SyncPolarity=HAL_DMAMUX_SYNC_NO_EVENT
Dma.SPI3_TX.1.SyncRequestNumber=1
Dma.SPI3_TX.1.SyncSignalID=NONE
FMC.CASLatency1=FMC_SDRAM_CAS_LATENCY_3
FMC.ExitSelfRefreshDelay1=7
FMC.LoadToActiveDelay1=2
FMC.RCDDelay1=2
FMC.RPDelay1=2
FMC.RPDelay2=2
FMC.ReadBurst1=FMC_SDRAM_RBURST_DISABLE
FMC.ReadPipeDelay1=FMC_SDRAM_RPIPE_DELAY_1
FMC.ReadPipeDelay2=FMC_SDRAM_RPIPE_DELAY_1
FMC.RowCycleDelay1=7
FMC.RowCycleDelay2=7
FMC.SDClockPeriod1=FMC_SDRAM_CLOCK_PERIOD_2
FMC.SDClockPeriod2=FMC_SDRAM_CLOCK_PERIOD_2
FMC.SelfRefreshTime1=5
FMC.WriteRecoveryTime1=3
FREERTOS.Queues01=HIDQ,8,uint16_t,0,Dynamic,NULL,NULL
FREERTOS.Tasks01=MotorTask,55,2048,StartMotorTask,Default,NULL,Dynamic,NULL,NULL;GUITask,31,6144,StartGUITask,Default,NULL,Dynamic,NULL,NULL;HIDTask,39,1024,StartHIDTask,Default,NULL,Dynamic,NULL,NULL;CommTask,31,1024,StartCommTask,Default,NULL,Dynamic,NULL,NULL;StorageTask,23,2048,StartStorageTask,Default,NULL,Dynamic,NULL,NULL;EXTITask,28,1024,StartEXTITask,Default,NULL,Dynamic,NULL,NULL;StepperTask,38,1024,StartStepperTask,Default,NULL,Dynamic,NULL,NULL
FREERTOS.configCHECK_FOR_STACK_OVERFLOW=2
FREERTOS.configTOTAL_HEAP_SIZE=262144
FREERTOS.configUSE_MALLOC_FAILED_HOOK=1
FREERTOS.configUSE_NEWLIB_REENTRANT=1
LTDC.ActiveH=272
LTDC.ActiveW=480
LTDC.Alpha0_L0=255
LTDC.Alpha0_L1=255
LTDC.Alpha_L0=255
LTDC.Alpha_L1=255
LTDC.BlendingFactor1_L1=LTDC_BLENDING_FACTOR1_PAxCA
LTDC.BlendingFactor2_L0=LTDC_BLENDING_FACTOR2_CA
LTDC.BlendingFactor2_L1=LTDC_BLENDING_FACTOR2_PAxCA
LTDC.DEPolarity=LTDC_DEPOLARITY_AH
LTDC.FBStartAdress_L0=0xC0000000
LTDC.FBStartAdress_L1=0xC001FFFF
LTDC.HBP=2
LTDC.HFP=2
LTDC.HSync=41
LTDC.ImageHeight_L0=272
LTDC.ImageHeight_L1=272
LTDC.ImageWidth_L0=480
LTDC.Layers=0
LTDC.PixelFormat_L0=LTDC_PIXEL_FORMAT_ARGB8888
LTDC.VBP=2
LTDC.VFP=8
LTDC.VSync=10
LTDC.WindowX1_L0=480
LTDC.WindowX1_L1=480
LTDC.WindowY1_L0=272
LTDC.WindowY1_L1=272
Mcu.Family=STM32H7
Mcu.Name=STM32H743IITx
Mcu.Package=LQFP176
NVIC.ADC_IRQn=true\:5\:0\:false\:false\:true\:true\:true\:true\:true
NVIC.DMA1_Stream2_IRQn=true\:5\:0\:false\:false\:true\:true\:false\:true\:true
NVIC.DMA1_Stream3_IRQn=true\:5\:0\:false\:false\:true\:true\:false\:true\:true
NVIC.DMA1_Stream4_IRQn=true\:5\:0\:false\:false\:true\:true\:false\:true\:true
NVIC.DMA1_Stream5_IRQn=true\:5\:0\:false\:false\:true\:true\:false\:true\:true
NVIC.EXTI15_10_IRQn=true\:5\:0\:false\:false\:true\:true\:true\:true\:true
NVIC.EXTI1_IRQn=true\:5\:0\:false\:false\:true\:true\:true\:true\:true
NVIC.EXTI2_IRQn=true\:5\:0\:false\:false\:true\:true\:true\:true\:true
NVIC.EXTI3_IRQn=true\:5\:0\:false\:false\:true\:true\:true\:true\:true
NVIC.EXTI9_5_IRQn=true\:5\:0\:false\:false\:true\:true\:true\:true\:true
NVIC.LTDC_IRQn=true\:5\:0\:false\:false\:true\:true\:true\:true\:true
NVIC.PriorityGroup=NVIC_PRIORITYGROUP_4
NVIC.SPI2_IRQn=true\:5\:0\:false\:false\:true\:true\:false\:true\:true
NVIC.SPI3_IRQn=true\:5\:0\:false\:false\:true\:true\:false\:true\:true
NVIC.TIM3_IRQn=true\:5\:0\:false\:false\:true\:true\:true\:true\:true
NVIC.TIM6_DAC_IRQn=true\:15\:0\:false\:false\:true\:false\:false\:true\:true
NVIC.TimeBase=TIM6_DAC_IRQn
NVIC.TimeBaseIP=TIM6
PA0.GPIO_Label=A_ENC
PA0.Signal=S_TIM2_CH1_ETR
PA1.GPIO_Label=B_ENC
PA1.Signal=S_TIM2_CH2
PA10.GPIO_Label=INHC
PA10.Signal=S_TIM1_CH3
PA11.GPIO_Speed=GPIO_SPEED_FREQ_VERY_HIGH
PA11.Mode=RGB888
PA11.Signal=LTDC_R4
PA12.GPIO_Label=ENC_SCK
PA12.Mode=Full_Duplex_Master
PA12.Signal=SPI2_SCK
PA13\ (JTMS/SWDIO).Mode=JTAG_5_pins
PA13\ (JTMS/SWDIO).Signal=DEBUG_JTMS-SWDIO
PA14\ (JTCK/SWCLK).Mode=JTAG_5_pins
PA14\ (JTCK/SWCLK).Signal=DEBUG_JTCK-SWCLK
PA15\ (JTDI).Mode=JTAG_5_pins
PA15\ (JTDI).Signal=DEBUG_JTDI
PA2.GPIO_Speed=GPIO_SPEED_FREQ_VERY_HIGH
PA2.Mode=RGB888
PA2.Signal=LTDC_R1
PA3.GPIO_Speed=GPIO_SPEED_FREQ_VERY_HIGH
PA3.Mode=RGB888
PA3.Signal=LTDC_B5
PA4.GPIO_Label=EXT_NSS
PA4.PinState=GPIO_PIN_SET
PA4.Signal=GPIO_Output
PA5.GPIO_Label=DRV_SCK
PA5.Mode=Full_Duplex_Master
PA5.Signal=SPI1_SCK
PA6.GPIO_Label=SOB
PA6.Signal=ADCx_INP3
PA7.GPIO_Label=A_UI_ENC
PA7.Signal=S_TIM3_CH2
PA8.GPIO_Label=INHA
PA8.Signal=S_TIM1_CH1
PA9.GPIO_Label=INHB
PA9.Signal=S_TIM1_CH2
PB0.GPIO_Speed=GPIO_SPEED_FREQ_VERY_HIGH
PB0.Mode=RGB888
PB0.Signal=LTDC_R3
PB1.GPIO_Label=I_ENC
PB1.GPIO_ModeDefaultEXTI=GPIO_MODE_IT_RISING
PB1.Signal=GPXTI1
PB10.Mode=Asynchronous
PB10.Signal=USART3_TX
PB11.Mode=Asynchronous
PB11.Signal=USART3_RX
PB12.GPIO_Label=DRV_NFAULT
PB12.Mode=Activate-Break-Input
PB12.Signal=TIM1_BKIN
PB13.GPIO_Label=INLA
PB13.Mode=PWM Generation1 CH1 CH1N
PB13.Signal=TIM1_CH1N
PB14.GPIO_Label=INLB
PB14.Mode=PWM Generation2 CH2 CH2N
PB14.Signal=TIM1_CH2N
PB15.GPIO_Label=INLC
PB15.Mode=PWM Generation3 CH3 CH3N
PB15.Signal=TIM1_CH3N
PB2.GPIO_Speed=GPIO_SPEED_FREQ_VERY_HIGH
PB2.Mode=Single Bank 1
PB2.Signal=QUADSPI_CLK
PB3\ (JTDO/TRACESWO).Mode=JTAG_5_pins
PB3\ (JTDO/TRACESWO).Signal=DEBUG_JTDO-SWO
PB4\ (NJTRST).Mode=JTAG_5_pins
PB4\ (NJTRST).Signal=DEBUG_JTRST
PB5.GPIO_Label=LTDC_STNDB
PB5.Signal=GPIO_Output
PB6.GPIO_Speed=GPIO_SPEED_FREQ_VERY_HIGH
PB6.Mode=Single Bank 1
PB6.Signal=QUADSPI_BK1_NCS
PB7.GPIO_Label=A_PED_ENC
PB7.Signal=S_TIM4_CH2
PB8.GPIO_Speed=GPIO_SPEED_FREQ_VERY_HIGH
PB8.Mode=RGB888
PB8.Signal=LTDC_B6
PB9.GPIO_Speed=GPIO_SPEED_FREQ_VERY_HIGH
PB9.Mode=RGB888
PB9.Signal=LTDC_B7
PC0.Signal=FMC_SDNWE
PC1.GPIO_Label=ENC_MOSI
PC1.Mode=Full_Duplex_Master
PC1.Signal=SPI2_MOSI
PC10.GPIO_Label=EXT_SCK
PC10.Mode=Full_Duplex_Master
PC10.Signal=SPI3_SCK
PC11.GPIO_Label=EXT_MISO
PC11.Mode=Full_Duplex_Master
PC11.Signal=SPI3_MISO
PC12.GPIO_Label=EXT_MOSI
PC12.Mode=Full_Duplex_Master
PC12.Signal=SPI3_MOSI
PC13.GPIO_Label=BACK_BUTTON
PC13.GPIO_ModeDefaultEXTI=GPIO_MODE_IT_FALLING
PC13.Signal=GPXTI13
PC14-OSC32_IN\ (OSC32_IN).GPIO_Label=LIMIT_BUTTON
PC14-OSC32_IN\ (OSC32_IN).GPIO_ModeDefaultEXTI=GPIO_MODE_IT_FALLING
PC14-OSC32_IN\ (OSC32_IN).Signal=GPXTI14
PC15-OSC32_OUT\ (OSC32_OUT).GPIO_Label=UI_ENC_BUTTON
PC15-OSC32_OUT\ (OSC32_OUT).GPIO_ModeDefaultEXTI=GPIO_MODE_IT_FALLING
PC15-OSC32_OUT\ (OSC32_OUT).Signal=GPXTI15
PC2_C.GPIO_Label=ENC_MISO
PC2_C.Mode=Full_Duplex_Master
PC2_C.Signal=SPI2_MISO
PC3_C.Mode=SdramChipSelect1_1
PC3_C.Signal=FMC_SDCKE0
PC4.GPIO_Label=SOA
PC4.Signal=ADCx_INP4
PC5.GPIO_Label=DRV_CAL
PC5.Signal=GPIO_Output
PC6.GPIO_Label=B_UI_ENC
PC6.Signal=S_TIM3_CH1
PC7.GPIO_Label=DIAG0
PC7.Signal=GPIO_Input
PC8.GPIO_Label=DIAG1
PC8.Signal=GPIO_Input
PC9.Mode=Clock-out-2
PC9.Signal=RCC_MCO_2
PD0.Signal=FMC_D2_DA2
PD1.Signal=FMC_D3_DA3
PD10.Signal=FMC_D15_DA15
PD11.GPIO_Label=DC_EN
PD11.Signal=GPIO_Output
PD12.GPIO_Label=B_PED_ENC
PD12.Signal=S_TIM4_CH1
PD13.GPIO_Speed=GPIO_SPEED_FREQ_VERY_HIGH
PD13.Mode=Single Bank 1
PD13.Signal=QUADSPI_BK1_IO3
PD14.Signal=FMC_D0_DA0
PD15.Signal=FMC_D1_DA1
PD2.GPIO_Label=FRW_BUT
PD2.Signal=GPXTI2
PD3.GPIO_Label=REV_BUT
PD3.Signal=GPXTI3
PD4.GPIO_Label=LED2
PD4.Signal=GPIO_Output
PD5.GPIO_Label=LED1
PD5.Signal=GPIO_Output
PD6.GPIO_Speed=GPIO_SPEED_FREQ_VERY_HIGH
PD6.Mode=RGB888
PD6.Signal=LTDC_B2
PD7.GPIO_Label=DRV_MOSI
PD7.Mode=Full_Duplex_Master
PD7.Signal=SPI1_MOSI
PD8.Signal=FMC_D13_DA13
PD9.Signal=FMC_D14_DA14
PE0.Signal=FMC_NBL0
PE1.Signal=FMC_NBL1
PE10.Signal=FMC_D7_DA7
PE11.Signal=FMC_D8_DA8
PE12.Signal=FMC_D9_DA9
PE13.Signal=FMC_D10_DA10
PE14.Signal=FMC_D11_DA11
PE15.Signal=FMC_D12_DA12
PE2.GPIO_Speed=GPIO_SPEED_FREQ_VERY_HIGH
PE2.Mode=Single Bank 1
PE2.Signal=QUADSPI_BK1_IO2
PE3.GPIO_Label=LED0
PE3.Signal=GPIO_Output
PE4.GPIO_Speed=GPIO_SPEED_FREQ_VERY_HIGH
PE4.Mode=RGB888
PE4.Signal=LTDC_B0
PE5.GPIO_Speed=GPIO_SPEED_FREQ_VERY_HIGH
PE5.Mode=RGB888
PE5.Signal=LTDC_G0
PE6.GPIO_Speed=GPIO_SPEED_FREQ_VERY_HIGH
PE6.Mode=RGB888
PE6.Signal=LTDC_G1
PE7.Signal=FMC_D4_DA4
PE8.Signal=FMC_D5_DA5
PE9.Signal=FMC_D6_DA6
PF0.Signal=FMC_A0
PF1.Signal=FMC_A1
PF10.GPIO_Speed=GPIO_SPEED_FREQ_VERY_HIGH
PF10.Mode=RGB888
PF10.Signal=LTDC_DE
PF11.Signal=FMC_SDNRAS
PF12.Signal=FMC_A6
PF13.Signal=FMC_A7
PF14.Signal=FMC_A8
PF15.Signal=FMC_A9
PF2.Signal=FMC_A2
PF3.Signal=FMC_A3
PF4.Signal=FMC_A4
PF5.Signal=FMC_A5
PF6.GPIO_Label=DRV_EN
PF6.Signal=GPIO_Output
PF7.GPIO_Label=SOC
PF7.Mode=IN3-Single-Ended
PF7.Signal=ADC3_INP3
PF8.GPIO_Speed=GPIO_SPEED_FREQ_VERY_HIGH
PF8.Mode=Single Bank 1
PF8.Signal=QUADSPI_BK1_IO0
PF9.GPIO_Speed=GPIO_SPEED_FREQ_VERY_HIGH
PF9.Mode=Single Bank 1
PF9.Signal=QUADSPI_BK1_IO1
PG0.Signal=FMC_A10
PG1.Signal=FMC_A11
PG10.GPIO_Label=DRV_NSS
PG10.PinState=GPIO_PIN_SET
PG10.Signal=GPIO_Output
PG11.GPIO_Speed=GPIO_SPEED_FREQ_VERY_HIGH
PG11.Mode=RGB888
PG11.Signal=LTDC_B3
PG12.GPIO_Speed=GPIO_SPEED_FREQ_VERY_HIGH
PG12.Mode=RGB888
PG12.Signal=LTDC_B1
PG13.GPIO_Label=QSPI_RST
PG13.Signal=GPIO_Output
PG15.Signal=FMC_SDNCAS
PG2.GPIO_Label=DC_IN
PG2.Signal=GPIO_Input
PG3.PinState=GPIO_PIN_SET
PG3.GPIO_Label=DRV_ENN
PG3.Signal=GPIO_Output
PG4.Signal=FMC_A14_BA0
PG5.Signal=FMC_A15_BA1
PG6.GPIO_Speed=GPIO_SPEED_FREQ_VERY_HIGH
PG6.Mode=RGB888
PG6.Signal=LTDC_R7
PG7.GPIO_Speed=GPIO_SPEED_FREQ_VERY_HIGH
PG7.Mode=RGB888
PG7.Signal=LTDC_CLK
PG8.Signal=FMC_SDCLK
PG9.GPIO_Label=DRV_MISO
PG9.Mode=Full_Duplex_Master
PG9.Signal=SPI1_MISO
PH0-OSC_IN\ (PH0).Mode=HSE-External-Oscillator
PH0-OSC_IN\ (PH0).Signal=RCC_OSC_IN
PH1-OSC_OUT\ (PH1).Mode=HSE-External-Oscillator
PH1-OSC_OUT\ (PH1).Signal=RCC_OSC_OUT
PH10.GPIO_Label=KLV_LED
PH10.Signal=S_TIM5_CH1
PH11.GPIO_Speed=GPIO_SPEED_FREQ_VERY_HIGH
PH11.Mode=RGB888
PH11.Signal=LTDC_R5
PH12.GPIO_Speed=GPIO_SPEED_FREQ_VERY_HIGH
PH12.Mode=RGB888
PH12.Signal=LTDC_R6
PH13.GPIO_Speed=GPIO_SPEED_FREQ_VERY_HIGH
PH13.Mode=RGB888
PH13.Signal=LTDC_G2
PH14.GPIO_Speed=GPIO_SPEED_FREQ_VERY_HIGH
PH14.Mode=RGB888
PH14.Signal=LTDC_G3
PH15.GPIO_Speed=GPIO_SPEED_FREQ_VERY_HIGH
PH15.Mode=RGB888
PH15.Signal=LTDC_G4
PH2.GPIO_Speed=GPIO_SPEED_FREQ_VERY_HIGH
PH2.Mode=RGB888
PH2.Signal=LTDC_R0
PH3.Mode=SdramChipSelect1_1
PH3.Signal=FMC_SDNE0
PH4.GPIO_Speed=GPIO_SPEED_FREQ_VERY_HIGH
PH4.Mode=RGB888
PH4.Signal=LTDC_G5
PH5.GPIO_Label=VREF_EN
PH5.Signal=GPIO_Output
PH6.GPIO_Label=FAN_FAULT
PH6.Signal=GPIO_Input
PH7.GPIO_Label=DIR
PH7.Signal=GPIO_Output
PH8.GPIO_Speed=GPIO_SPEED_FREQ_VERY_HIGH
PH8.Mode=RGB888
PH8.Signal=LTDC_R2
PH9.GPIO_Label=STEP
PH9.Signal=S_TIM12_CH2
PI0.GPIO_Label=ENC_NSS
PI0.PinState=GPIO_PIN_SET
PI0.Signal=GPIO_Output
PI1.GPIO_Label=DCO
PI1.Signal=GPIO_Output
PI10.GPIO_Speed=GPIO_SPEED_FREQ_VERY_HIGH
PI10.Mode=RGB888
PI10.Signal=LTDC_HSYNC
PI11.GPIO_Speed=GPIO_SPEED_FREQ_VERY_HIGH
PI11.Mode=RGB888
PI11.Signal=LTDC_G6
PI2.GPIO_Speed=GPIO_SPEED_FREQ_VERY_HIGH
PI2.Mode=RGB888
PI2.Signal=LTDC_G7
PI3.GPIO_Label=SPI_MODE
PI3.Signal=GPIO_Output
PI4.GPIO_Speed=GPIO_SPEED_FREQ_VERY_HIGH
PI4.Mode=RGB888
PI4.Signal=LTDC_B4
PI5.GPIO_Label=BUZZER
PI5.Signal=S_TIM8_CH1
PI6.GPIO_Label=VIB
PI6.Signal=GPIO_Output
PI7.GPIO_Label=TEST
PI7.Signal=GPIO_Input
PI8.GPIO_Label=SIDE_BUTTON
PI8.GPIO_ModeDefaultEXTI=GPIO_MODE_IT_FALLING
PI8.Signal=GPXTI8
PI9.GPIO_Speed=GPIO_SPEED_FREQ_VERY_HIGH
PI9.Mode=RGB888
PI9.Signal=LTDC_VSYNC
ProjectManager.HeapSize=0x200
ProjectManager.StackSize=0x400
ProjectManager.TargetToolchain=STM32CubeIDE
QUADSPI.ChipSelectHighTime=QSPI_CS_HIGH_TIME_2_CYCLE
QUADSPI.ClockPrescaler=3
QUADSPI.FifoThreshold=4
QUADSPI.FlashSize=24
QUADSPI.SampleShifting=QSPI_SAMPLE_SHIFTING_NONE
RCC.ADCFreq_Value=96875000
RCC.APB1Freq_Value=112500000
RCC.APB2Freq_Value=112500000
RCC.APB3Freq_Value=112500000
RCC.APB4Freq_Value=112500000
RCC.CortexFreq_Value=450000000
RCC.D1PPRE=RCC_APB3_DIV2
RCC.D2PPRE1=RCC_APB1_DIV2
RCC.D2PPRE2=RCC_APB2_DIV2
RCC.D3PPRE=RCC_APB4_DIV2
RCC.DIVM1=2
RCC.DIVM2=4
RCC.DIVM3=2
RCC.DIVN1=72
RCC.DIVN2=62
RCC.DIVN3=23
RCC.DIVP2=4
RCC.DIVQ1=7
RCC.DIVR3=31
RCC.EnbaleCSS=true
RCC.FMCCLockSelection=RCC_FMCCLKSOURCE_PLL2
RCC.HCLKFreq_Value=225000000
RCC.HPRE=RCC_HCLK_DIV2
RCC.PLL2FRACN=0
RCC.PLL3FRACN=0
RCC.PLL3_VCO_SEL-AdvancedSettings=RCC_PLL3VCOMEDIUM
RCC.PLLFRACN=0
RCC.PLLSourceVirtual=RCC_PLLSOURCE_HSE
RCC.QSPICLockSelection=RCC_QSPICLKSOURCE_PLL2
RCC.RCC_MCO2Source=RCC_MCO2SOURCE_HSE
RCC.RCC_MCODiv2=RCC_MCODIV_2
RCC.SYSCLKFreq_VALUE=450000000
RCC.SYSCLKSource=RCC_SYSCLKSOURCE_PLLCLK
RCC.USBFreq_Value=128571428.57142857
SH.ADCx_INP3.0=ADC2_INP3,IN3-Single-Ended
SH.ADCx_INP4.0=ADC1_INP4,IN4-Single-Ended
SH.FMC_A0.0=FMC_A0,12b-sda1
SH.FMC_A1.0=FMC_A1,12b-sda1
SH.FMC_A10.0=FMC_A10,12b-sda1
SH.FMC_A11.0=FMC_A11,12b-sda1
SH.FMC_A14_BA0.0=FMC_BA0,FourSdramBanks1
SH.FMC_A15_BA1.0=FMC_BA1,FourSdramBanks1
SH.FMC_A2.0=FMC_A2,12b-sda1
SH.FMC_A3.0=FMC_A3,12b-sda1
SH.FMC_A4.0=FMC_A4,12b-sda1
SH.FMC_A5.0=FMC_A5,12b-sda1
SH.FMC_A6.0=FMC_A6,12b-sda1
SH.FMC_A7.0=FMC_A7,12b-sda1
SH.FMC_A8.0=FMC_A8,12b-sda1
SH.FMC_A9.0=FMC_A9,12b-sda1
SH.FMC_D0_DA0.0=FMC_D0,sd-16b-d1
SH.FMC_D10_DA10.0=FMC_D10,sd-16b-d1
SH.FMC_D11_DA11.0=FMC_D11,sd-16b-d1
SH.FMC_D12_DA12.0=FMC_D12,sd-16b-d1
SH.FMC_D13_DA13.0=FMC_D13,sd-16b-d1
SH.FMC_D14_DA14.0=FMC_D14,sd-16b-d1
SH.FMC_D15_DA15.0=FMC_D15,sd-16b-d1
SH.FMC_D1_DA1.0=FMC_D1,sd-16b-d1
SH.FMC_D2_DA2.0=FMC_D2,sd-16b-d1
SH.FMC_D3_DA3.0=FMC_D3,sd-16b-d1
SH.FMC_D4_DA4.0=FMC_D4,sd-16b-d1
SH.FMC_D5_DA5.0=FMC_D5,sd-16b-d1
SH.FMC_D6_DA6.0=FMC_D6,sd-16b-d1
SH.FMC_D7_DA7.0=FMC_D7,sd-16b-d1
SH.FMC_D8_DA8.0=FMC_D8,sd-16b-d1
SH.FMC_D9_DA9.0=FMC_D9,sd-16b-d1
SH.FMC_NBL0.0=FMC_NBL0,Sd2ByteEnable1
SH.FMC_NBL1.0=FMC_NBL1,Sd2ByteEnable1
SH.FMC_SDCLK.0=FMC_SDCLK,12b-sda1
SH.FMC_SDNCAS.0=FMC_SDNCAS,12b-sda1
SH.FMC_SDNRAS.0=FMC_SDNRAS,12b-sda1
SH.FMC_SDNWE.0=FMC_SDNWE,12b-sda1
SH.S_TIM12_CH2.0=TIM12_CH2,PWM Generation2 CH2
SH.S_TIM1_CH1.0=TIM1_CH1,PWM Generation1 CH1 CH1N
SH.S_TIM1_CH2.0=TIM1_CH2,PWM Generation2 CH2 CH2N
SH.S_TIM1_CH3.0=TIM1_CH3,PWM Generation3 CH3 CH3N
SH.S_TIM2_CH1_ETR.0=TIM2_CH1,Encoder_Interface
SH.S_TIM2_CH2.0=TIM2_CH2,Encoder_Interface
SH.S_TIM3_CH1.0=TIM3_CH1,Encoder_Interface
SH.S_TIM3_CH2.0=TIM3_CH2,Encoder_Interface
SH.S_TIM4_CH1.0=TIM4_CH1,Encoder_Interface
SH.S_TIM4_CH2.0=TIM4_CH2,Encoder_Interface
SH.S_TIM5_CH1.0=TIM5_CH1,PWM Generation1 CH1
SH.S_TIM8_CH1.0=TIM8_CH1,PWM Generation1 CH1
SPI1.BaudRatePrescaler=SPI_BAUDRATEPRESCALER_16
SPI1.CLKPhase=SPI_PHASE_2EDGE
SPI1.CalculateBaudRate=8.035714 MBits/s
SPI1.DataSize=SPI_DATASIZE_16BIT
SPI1.Direction=SPI_DIRECTION_2LINES
SPI1.Mode=SPI_MODE_MASTER
SPI1.VirtualType=VM_MASTER
SPI2.BaudRatePrescaler=SPI_BAUDRATEPRESCALER_16
SPI2.CLKPhase=SPI_PHASE_2EDGE
SPI2.CalculateBaudRate=8.035714 MBits/s
SPI2.DataSize=SPI_DATASIZE_16BIT
SPI2.Direction=SPI_DIRECTION_2LINES
SPI2.Mode=SPI_MODE_MASTER
SPI2.VirtualType=VM_MASTER
SPI3.BaudRatePrescaler=SPI_BAUDRATEPRESCALER_128
SPI3.CalculateBaudRate=1.004464 MBits/s
SPI3.DataSize=SPI_DATASIZE_8BIT
SPI3.Direction=SPI_DIRECTION_2LINES
SPI3.CLKPolarity=SPI_POLARITY_HIGH
SPI3.CLKPhase=SPI_PHASE_2EDGE
SPI3.Mode=SPI_MODE_MASTER
SPI3.VirtualType=VM_MASTER
STMicroelectronics.X-CUBE-TOUCHGFX.4.27.0.ApplicationCcGraphicsJjApplication=TouchGFXOoGenerator
STMicroelectronics.X-CUBE-TOUCHGFX.4.27.0.tgfx_address1=0xC0000000
STMicroelectronics.X-CUBE-TOUCHGFX.4.27.0.tgfx_address2=0xC007F800
STMicroelectronics.X-CUBE-TOUCHGFX.4.27.0.tgfx_buffering_strategy=Double
STMicroelectronics.X-CUBE-TOUCHGFX.4.27.0.tgfx_custom_height=272
STMicroelectronics.X-CUBE-TOUCHGFX.4.27.0.tgfx_display_interface=disp_ltdc
STMicroelectronics.X-CUBE-TOUCHGFX.4.27.0.tgfx_framebuffer_stride=Enabled
STMicroelectronics.X-CUBE-TOUCHGFX.4.27.0.tgfx_hardware_accelerator=dma_2d
STMicroelectronics.X-CUBE-TOUCHGFX.4.27.0.tgfx_location=By Address
STMicroelectronics.X-CUBE-TOUCHGFX.4.27.0.tgfx_oswrapper=CMSIS V2
STMicroelectronics.X-CUBE-TOUCHGFX.4.27.0.tgfx_pixel_format=ARGB8888\:32
STMicroelectronics.X-CUBE-TOUCHGFX.4.27.0_IsPackSelfContextualization=true
TIM1.AutoReloadPreload=TIM_AUTORELOAD_PRELOAD_ENABLE
TIM1.BreakPolarity=TIM_BREAKPOLARITY_LOW
TIM1.BreakState=TIM_BREAK_ENABLE
TIM1.Channel-PWM\ Generation1\ CH1\ CH1N=TIM_CHANNEL_1
TIM1.Channel-PWM\ Generation2\ CH2\ CH2N=TIM_CHANNEL_2
TIM1.Channel-PWM\ Generation3\ CH3\ CH3N=TIM_CHANNEL_3
TIM1.Channel-PWM\ Generation4\ No\ Output=TIM_CHANNEL_4
TIM1.CounterMode=TIM_COUNTERMODE_CENTERALIGNED3
TIM1.DeadTime=30
TIM1.OffStateRunMode=TIM_OSSR_ENABLE
TIM1.OffStateIDLEMode=TIM_OSSI_ENABLE
TIM1.Period=2812
TIM1.Prescaler=1
TIM1.Pulse-PWM\ Generation1\ CH1\ CH1N=1406-1
TIM1.Pulse-PWM\ Generation2\ CH2\ CH2N=1406-1
TIM1.Pulse-PWM\ Generation3\ CH3\ CH3N=1406-1
TIM1.Pulse-PWM\ Generation4\ No\ Output=2100
TIM1.TIM_MasterOutputTrigger2=TIM_TRGO2_OC4REF
TIM12.Channel-PWM\ Generation2\ CH2=TIM_CHANNEL_2
TIM2.EncoderMode=TIM_ENCODERMODE_TI12
TIM3.IC1Filter=10
TIM3.IC1Polarity=TIM_ICPOLARITY_FALLING
TIM3.IC2Filter=10
TIM3.IC2Polarity=TIM_ICPOLARITY_FALLING
TIM3.Period=9999
TIM5.AutoReloadPreload=TIM_AUTORELOAD_PRELOAD_ENABLE
TIM5.Channel-PWM\ Generation1\ CH1=TIM_CHANNEL_1
TIM5.Period=99
TIM5.Prescaler=124
TIM5.Pulse-PWM\ Generation1\ CH1=49
TIM8.Channel-PWM\ Generation1\ CH1=TIM_CHANNEL_1
USART3.VirtualMode-Asynchronous=VM_ASYNC
VP_CRC_VS_CRC.Mode=CRC_Activate
VP_DMA2D_VS_DMA2D.Mode=DMA2D_Activate
VP_FREERTOS_VS_CMSIS_V2.Mode=CMSIS_V2
VP_MEMORYMAP_VS_MEMORYMAP.Mode=CurAppReg
VP_STMicroelectronics.X-CUBE-TOUCHGFX_VS_GraphicsJjApplication_4.27.0.Mode=GraphicsJjApplication
VP_SYS_VS_tim6.Mode=TIM6
VP_TIM1_VS_no_output4.Mode=PWM Generation4 No Output
board=custom

// file: Core/Src/main.c
/* USER CODE BEGIN Header */
/**
 ******************************************************************************
 * @file           : main.c
 * @brief          : Main program body
 ******************************************************************************
 * @attention
 *
 * Copyright (c) 2026 STMicroelectronics.
 * All rights reserved.
 *
 * This software is licensed under terms that can be found in the LICENSE file
 * in the root directory of this software component.
 * If no LICENSE file comes with this software, it is provided AS-IS.
 *
 ******************************************************************************
 */
/* USER CODE END Header */
#include "main.h"
#include "FreeRTOS.h"
#include "cmsis_os2.h"
#include "adc.h"
#include "crc.h"
#include "dma.h"
#include "dma2d.h"
#include "ltdc.h"
#include "quadspi.h"
#include "spi.h"
#include "tim.h"
#include "usart.h"
#include "gpio.h"
#include "fmc.h"
#include "app_touchgfx.h"

/* USER CODE BEGIN Includes */
#include <string.h>
#include "motor_foc.h"
#include "telemetry.h"
#include "leds.h"
#include "buzzer.h"
#include "drv_spi.h"
#include "s25fl256s.h"
#include "fault_manager.h"
/* USER CODE END Includes */

/* USER CODE BEGIN PTD */
extern TIM_HandleTypeDef htim8;
extern SPI_HandleTypeDef hspi1;
/* USER CODE END PTD */

/* USER CODE BEGIN PV */
Buzzer_Handle_t g_buzzer; /* shared with the HID task feedback patterns */
drv8323_spi_t g_drv8323 = { .hspi = &hspi1,
		.ncs_port = DRV_NSS_GPIO_Port, .ncs_pin = DRV_NSS_Pin, .en_port =
				DRV_EN_GPIO_Port, .en_pin = DRV_EN_Pin, .spi_timeout_ms = 5, };
/* USER CODE END PV */

void SystemClock_Config(void);
void PeriphCommonClock_Config(void);
static void MPU_Config(void);
void MX_FREERTOS_Init(void);

int main(void)
{

  /* MPU Configuration--------------------------------------------------------*/
  MPU_Config();

  /* Enable the CPU Cache */

  /* Enable I-Cache---------------------------------------------------------*/
  SCB_EnableICache();

  /* Enable D-Cache---------------------------------------------------------*/
  SCB_EnableDCache();

  /* MCU Configuration--------------------------------------------------------*/

  /* Reset of all peripherals, Initializes the Flash interface and the Systick. */
  HAL_Init();

  /* Configure the system clock */
  SystemClock_Config();

  /* Configure the peripherals common clocks */
  PeriphCommonClock_Config();

  /* Initialize all configured peripherals */
  MX_GPIO_Init();
  MX_DMA_Init();
  MX_ADC1_Init();
  MX_ADC2_Init();
  MX_ADC3_Init();
  MX_QUADSPI_Init();
  MX_FMC_Init();
  MX_LTDC_Init();
  MX_DMA2D_Init();
  MX_SPI1_Init();
  MX_SPI2_Init();
  MX_SPI3_Init();
  MX_TIM1_Init();
  MX_TIM2_Init();
  MX_TIM3_Init();
  MX_TIM4_Init();
  MX_TIM8_Init();
  MX_TIM5_Init();
  MX_USART3_UART_Init();
  MX_CRC_Init();
  MX_TIM12_Init();
  MX_TouchGFX_Init();
  /* Call PreOsInit function */
  MX_TouchGFX_PreOSInit();
  /* USER CODE BEGIN 2 */

  /* MotorFOC_Start/Arm configure and verify DRV with timer outputs inhibited. */
	Buzzer_Init(&g_buzzer, &htim8);
	Buzzer_Beep(&g_buzzer, 2000, 80, 50);
	HAL_TIM_PWM_Start(&htim5, TIM_CHANNEL_1);
//	HAL_TIMEx_PWMN_Start(&htim5, TIM_CHANNEL_1);
	__HAL_TIM_SET_COMPARE(&htim5, TIM_CHANNEL_1, 0);
	HAL_Delay(100);
	HAL_GPIO_WritePin(LTDC_STNDB_GPIO_Port, LTDC_STNDB_Pin, GPIO_PIN_SET);
	HAL_GPIO_WritePin(VREF_EN_GPIO_Port, VREF_EN_Pin, GPIO_PIN_SET);
	//Telemetry_Init();
//	__HAL_TIM_SET_COMPARE(&htim5, TIM_CHANNEL_1, 25);
//	HAL_Delay(5000);
	HAL_TIM_Encoder_Start(&htim3, TIM_CHANNEL_ALL);
	HAL_TIM_Encoder_Start(&htim4, TIM_CHANNEL_ALL); /* pedal encoder, zeroed by the home switch */

	HAL_GPIO_WritePin(VIB_GPIO_Port, VIB_Pin, GPIO_PIN_SET);
	HAL_Delay(50);
	HAL_GPIO_WritePin(VIB_GPIO_Port, VIB_Pin, GPIO_PIN_RESET);

  /* Arming is an explicit application command after calibration. */

  /* USER CODE END 2 */

  /* Init scheduler */
  osKernelInitialize();  /* Call init function for freertos objects (in cmsis_os2.c) */
  MX_FREERTOS_Init();

  /* Start scheduler */
  osKernelStart();

  /* We should never get here as control is now taken by the scheduler */

  /* Infinite loop */
	while (1) {

	}
}

void SystemClock_Config(void)
{
  RCC_OscInitTypeDef RCC_OscInitStruct = {0};
  RCC_ClkInitTypeDef RCC_ClkInitStruct = {0};

  /** Supply configuration update enable
  */
  HAL_PWREx_ConfigSupply(PWR_LDO_SUPPLY);

  /** Configure the main internal regulator output voltage
  */
  __HAL_PWR_VOLTAGESCALING_CONFIG(PWR_REGULATOR_VOLTAGE_SCALE0);

  while(!__HAL_PWR_GET_FLAG(PWR_FLAG_VOSRDY)) {}

  /** Initializes the RCC Oscillators according to the specified parameters
  * in the RCC_OscInitTypeDef structure.
  */
  RCC_OscInitStruct.OscillatorType = RCC_OSCILLATORTYPE_HSE;
  RCC_OscInitStruct.HSEState = RCC_HSE_ON;
  RCC_OscInitStruct.PLL.PLLState = RCC_PLL_ON;
  RCC_OscInitStruct.PLL.PLLSource = RCC_PLLSOURCE_HSE;
  RCC_OscInitStruct.PLL.PLLM = 2;
  RCC_OscInitStruct.PLL.PLLN = 72;
  RCC_OscInitStruct.PLL.PLLP = 2;
  RCC_OscInitStruct.PLL.PLLQ = 7;
  RCC_OscInitStruct.PLL.PLLR = 2;
  RCC_OscInitStruct.PLL.PLLRGE = RCC_PLL1VCIRANGE_3;
  RCC_OscInitStruct.PLL.PLLVCOSEL = RCC_PLL1VCOWIDE;
  RCC_OscInitStruct.PLL.PLLFRACN = 0;
  if (HAL_RCC_OscConfig(&RCC_OscInitStruct) != HAL_OK)
  {
    Error_Handler();
  }

  /** Initializes the CPU, AHB and APB buses clocks
  */
  RCC_ClkInitStruct.ClockType = RCC_CLOCKTYPE_HCLK|RCC_CLOCKTYPE_SYSCLK
                              |RCC_CLOCKTYPE_PCLK1|RCC_CLOCKTYPE_PCLK2
                              |RCC_CLOCKTYPE_D3PCLK1|RCC_CLOCKTYPE_D1PCLK1;
  RCC_ClkInitStruct.SYSCLKSource = RCC_SYSCLKSOURCE_PLLCLK;
  RCC_ClkInitStruct.SYSCLKDivider = RCC_SYSCLK_DIV1;
  RCC_ClkInitStruct.AHBCLKDivider = RCC_HCLK_DIV2;
  RCC_ClkInitStruct.APB3CLKDivider = RCC_APB3_DIV2;
  RCC_ClkInitStruct.APB1CLKDivider = RCC_APB1_DIV2;
  RCC_ClkInitStruct.APB2CLKDivider = RCC_APB2_DIV2;
  RCC_ClkInitStruct.APB4CLKDivider = RCC_APB4_DIV2;

  if (HAL_RCC_ClockConfig(&RCC_ClkInitStruct, FLASH_LATENCY_3) != HAL_OK)
  {
    Error_Handler();
  }
  HAL_RCC_MCOConfig(RCC_MCO2, RCC_MCO2SOURCE_HSE, RCC_MCODIV_2);

  /** Enables the Clock Security System
  */
  HAL_RCC_EnableCSS();
}

void PeriphCommonClock_Config(void)
{
  RCC_PeriphCLKInitTypeDef PeriphClkInitStruct = {0};

  /** Initializes the peripherals clock
  */
  PeriphClkInitStruct.PeriphClockSelection = RCC_PERIPHCLK_FMC|RCC_PERIPHCLK_QSPI
                              |RCC_PERIPHCLK_ADC;
  PeriphClkInitStruct.PLL2.PLL2M = 4;
  PeriphClkInitStruct.PLL2.PLL2N = 62;
  PeriphClkInitStruct.PLL2.PLL2P = 4;
  PeriphClkInitStruct.PLL2.PLL2Q = 2;
  PeriphClkInitStruct.PLL2.PLL2R = 2;
  PeriphClkInitStruct.PLL2.PLL2RGE = RCC_PLL2VCIRANGE_2;
  PeriphClkInitStruct.PLL2.PLL2VCOSEL = RCC_PLL2VCOWIDE;
  PeriphClkInitStruct.PLL2.PLL2FRACN = 0;
  PeriphClkInitStruct.FmcClockSelection = RCC_FMCCLKSOURCE_PLL2;
  PeriphClkInitStruct.QspiClockSelection = RCC_QSPICLKSOURCE_PLL2;
  PeriphClkInitStruct.AdcClockSelection = RCC_ADCCLKSOURCE_PLL2;
  if (HAL_RCCEx_PeriphCLKConfig(&PeriphClkInitStruct) != HAL_OK)
  {
    Error_Handler();
  }
}

 /* MPU Configuration */

void MPU_Config(void)
{
  MPU_Region_InitTypeDef MPU_InitStruct = {0};

  /* Disables the MPU */
  HAL_MPU_Disable();

  /** Initializes and configures the Region and the memory to be protected
  */
  MPU_InitStruct.Enable = MPU_REGION_ENABLE;
  MPU_InitStruct.Number = MPU_REGION_NUMBER0;
  MPU_InitStruct.BaseAddress = 0x0;
  MPU_InitStruct.Size = MPU_REGION_SIZE_4GB;
  MPU_InitStruct.SubRegionDisable = 0x87;
  MPU_InitStruct.TypeExtField = MPU_TEX_LEVEL0;
  MPU_InitStruct.AccessPermission = MPU_REGION_NO_ACCESS;
  MPU_InitStruct.DisableExec = MPU_INSTRUCTION_ACCESS_DISABLE;
  MPU_InitStruct.IsShareable = MPU_ACCESS_SHAREABLE;
  MPU_InitStruct.IsCacheable = MPU_ACCESS_NOT_CACHEABLE;
  MPU_InitStruct.IsBufferable = MPU_ACCESS_NOT_BUFFERABLE;

  HAL_MPU_ConfigRegion(&MPU_InitStruct);

  /** Initializes and configures the Region and the memory to be protected
  */
  MPU_InitStruct.Number = MPU_REGION_NUMBER1;
  MPU_InitStruct.BaseAddress = 0x08000000;
  MPU_InitStruct.Size = MPU_REGION_SIZE_2MB;
  MPU_InitStruct.SubRegionDisable = 0x0;
  MPU_InitStruct.TypeExtField = MPU_TEX_LEVEL1;
  MPU_InitStruct.AccessPermission = MPU_REGION_PRIV_RO;
  MPU_InitStruct.DisableExec = MPU_INSTRUCTION_ACCESS_ENABLE;
  MPU_InitStruct.IsShareable = MPU_ACCESS_NOT_SHAREABLE;
  MPU_InitStruct.IsCacheable = MPU_ACCESS_CACHEABLE;

  HAL_MPU_ConfigRegion(&MPU_InitStruct);

  /** Initializes and configures the Region and the memory to be protected
  */
  MPU_InitStruct.Number = MPU_REGION_NUMBER2;
  MPU_InitStruct.BaseAddress = 0x90000000;
  MPU_InitStruct.Size = MPU_REGION_SIZE_32MB;
  MPU_InitStruct.AccessPermission = MPU_REGION_FULL_ACCESS;
  MPU_InitStruct.DisableExec = MPU_INSTRUCTION_ACCESS_DISABLE;
  MPU_InitStruct.IsShareable = MPU_ACCESS_SHAREABLE;
  MPU_InitStruct.IsCacheable = MPU_ACCESS_NOT_CACHEABLE;

  HAL_MPU_ConfigRegion(&MPU_InitStruct);

  /** Initializes and configures the Region and the memory to be protected
  */
  MPU_InitStruct.Number = MPU_REGION_NUMBER3;
  MPU_InitStruct.BaseAddress = 0xC0000000;
  MPU_InitStruct.Size = MPU_REGION_SIZE_8MB;
  MPU_InitStruct.TypeExtField = MPU_TEX_LEVEL1; /* Normal, non-cacheable SDRAM */
  MPU_InitStruct.IsCacheable = MPU_ACCESS_NOT_CACHEABLE;
  MPU_InitStruct.DisableExec = MPU_INSTRUCTION_ACCESS_DISABLE;
  MPU_InitStruct.IsShareable = MPU_ACCESS_NOT_SHAREABLE;
  MPU_InitStruct.IsBufferable = MPU_ACCESS_NOT_BUFFERABLE;

  HAL_MPU_ConfigRegion(&MPU_InitStruct);
  /* Enables the MPU */
  HAL_MPU_Enable(MPU_PRIVILEGED_DEFAULT);

}

void HAL_TIM_PeriodElapsedCallback(TIM_HandleTypeDef *htim)
{
  if (htim->Instance == TIM6)
  {
    HAL_IncTick();
  }
}

void Error_Handler(void)
{
  /* USER CODE BEGIN Error_Handler_Debug */
	/* User can add his own implementation to report the HAL error return state */
	Fault_Report(FAULT_CPU);
	__disable_irq();
	while (1) {
	}
  /* USER CODE END Error_Handler_Debug */
}
#ifdef USE_FULL_ASSERT
/**
  * @brief  Reports the name of the source file and the source line number
  *         where the assert_param error has occurred.
  * @param  file: pointer to the source file name
  * @param  line: assert_param error line source number
  * @retval None
  */
void assert_failed(uint8_t *file, uint32_t line)
{
  /* USER CODE BEGIN 6 */
	/* A HAL parameter check failed: treat it like any other HAL error and
	   latch outputs off instead of continuing with an invalid configuration. */
	(void)file;
	(void)line;
	Error_Handler();
  /* USER CODE END 6 */
}
#endif /* USE_FULL_ASSERT */

// file: Core/Src/freertos.c
/* USER CODE BEGIN Header */
/**
  ******************************************************************************
  * File Name          : freertos.c
  * Description        : Code for freertos applications
  ******************************************************************************
  * @attention
  *
  * Copyright (c) 2026 STMicroelectronics.
  * All rights reserved.
  *
  * This software is licensed under terms that can be found in the LICENSE file
  * in the root directory of this software component.
  * If no LICENSE file comes with this software, it is provided AS-IS.
  *
  ******************************************************************************
  */
/* USER CODE END Header */

#include "FreeRTOS.h"
#include "task.h"
#include "main.h"
#include "FreeRTOS.h"
#include "cmsis_os2.h"

/* USER CODE BEGIN Includes */
#include <string.h>
#include "motor_foc.h"
#include "telemetry.h"
#include "leds.h"
#include "buzzer.h"
#include "drv_spi.h"
#include "app_touchgfx.h"
#include "main.h"
#include "tmc2130.h"
#include "tmc2130_motion.h"
#include "fault_manager.h"
#include "spi.h"
#include "tim.h"
#include "ui_api.h"
#include "operator_input.h"
#include "ui_input.h"
#include <math.h>
/* USER CODE END Includes */

/* USER CODE BEGIN PTD */
extern TIM_HandleTypeDef htim2;
extern TIM_HandleTypeDef htim3;
extern TIM_HandleTypeDef htim4;
extern TIM_HandleTypeDef htim5;
/* USER CODE END PTD */

/* USER CODE BEGIN PD */
// bitmask events
#define EVT_PEDAL_HOME (1u << 0)
#define EVT_FAN	    (1u << 3)
#define EVT_ENC_I	(1u << 5)

#ifndef ENABLE_DEBUG_TELEMETRY
#define ENABLE_DEBUG_TELEMETRY 0
#endif
/* USER CODE END PD */

/* USER CODE BEGIN Variables */
float ped_enc = 0;
TMC2130_Handle_t g_tmc2130;
TMC2130Motion_Handle_t g_stepper_motion;
/* USER CODE END Variables */
/* Definitions for MotorTask */
osThreadId_t MotorTaskHandle;
const osThreadAttr_t MotorTask_attributes = {
  .name = "MotorTask",
  .stack_size = 2048 * 4,
  .priority = (osPriority_t) osPriorityRealtime7,
};
/* Definitions for GUITask */
osThreadId_t GUITaskHandle;
const osThreadAttr_t GUITask_attributes = {
  .name = "GUITask",
  .stack_size = 6144 * 4,
  .priority = (osPriority_t) osPriorityNormal7,
};
/* Definitions for HIDTask */
osThreadId_t HIDTaskHandle;
const osThreadAttr_t HIDTask_attributes = {
  .name = "HIDTask",
  .stack_size = 1024 * 4,
  .priority = (osPriority_t) osPriorityAboveNormal7,
};
/* Definitions for CommTask */
osThreadId_t CommTaskHandle;
const osThreadAttr_t CommTask_attributes = {
  .name = "CommTask",
  .stack_size = 1024 * 4,
  .priority = (osPriority_t) osPriorityNormal7,
};
/* Definitions for StorageTask */
osThreadId_t StorageTaskHandle;
const osThreadAttr_t StorageTask_attributes = {
  .name = "StorageTask",
  .stack_size = 2048 * 4,
  .priority = (osPriority_t) osPriorityBelowNormal7,
};
/* Definitions for EXTITask */
osThreadId_t EXTITaskHandle;
const osThreadAttr_t EXTITask_attributes = {
  .name = "EXTITask",
  .stack_size = 1024 * 4,
  .priority = (osPriority_t) osPriorityNormal4,
};
/* Definitions for StepperTask */
osThreadId_t StepperTaskHandle;
const osThreadAttr_t StepperTask_attributes = {
  .name = "StepperTask",
  .stack_size = 1024 * 4,
  .priority = (osPriority_t) osPriorityAboveNormal6,
};
/* Definitions for HIDQ */
osMessageQueueId_t HIDQHandle;
const osMessageQueueAttr_t HIDQ_attributes = {
  .name = "HIDQ"
};

void StartMotorTask(void *argument);
void StartGUITask(void *argument);
void StartHIDTask(void *argument);
void StartCommTask(void *argument);
void StartStorageTask(void *argument);
void StartEXTITask(void *argument);
void StartStepperTask(void *argument);

void MX_FREERTOS_Init(void); /* (MISRA C 2004 rule 8.1) */

/* Hook prototypes */
void vApplicationStackOverflowHook(xTaskHandle xTask, char *pcTaskName);
void vApplicationMallocFailedHook(void);

/* USER CODE BEGIN 4 */
void vApplicationStackOverflowHook(TaskHandle_t xTask, char *pcTaskName)
{
    (void)xTask;
    (void)pcTaskName;

    Fault_Report(FAULT_CPU);
    taskDISABLE_INTERRUPTS();
    for (;;)
    {
    }
}
/* USER CODE END 4 */

/* USER CODE BEGIN 5 */
void vApplicationMallocFailedHook(void)
{
    Fault_Report(FAULT_CPU);
    taskDISABLE_INTERRUPTS();
    for (;;) {}
   /* vApplicationMallocFailedHook() will only be called if
   configUSE_MALLOC_FAILED_HOOK is set to 1 in FreeRTOSConfig.h. It is a hook
   function that will get called if a call to pvPortMalloc() fails.
   pvPortMalloc() is called internally by the kernel whenever a task, queue,
   timer or semaphore is created. It is also called by various parts of the
   demo application. If heap_1.c or heap_2.c are used, then the size of the
   heap available to pvPortMalloc() is defined by configTOTAL_HEAP_SIZE in
   FreeRTOSConfig.h, and the xPortGetFreeHeapSize() API function can be used
   to query the size of free heap space that remains (although it does not
   provide information on how the remaining heap might be fragmented). */
}
/* USER CODE END 5 */

void MX_FREERTOS_Init(void) {

  /* Create the queue(s) */
  /* creation of HIDQ */
  HIDQHandle = osMessageQueueNew (8, sizeof(uint16_t), &HIDQ_attributes);

  /* USER CODE BEGIN RTOS_QUEUES */
  UI_InitCommandQueues();
  /* add queues, ... */
  /* USER CODE END RTOS_QUEUES */

  /* Create the thread(s) */
  /* creation of MotorTask */
  MotorTaskHandle = osThreadNew(StartMotorTask, NULL, &MotorTask_attributes);

  /* creation of GUITask */
  GUITaskHandle = osThreadNew(StartGUITask, NULL, &GUITask_attributes);

  /* creation of HIDTask */
  HIDTaskHandle = osThreadNew(StartHIDTask, NULL, &HIDTask_attributes);

  /* creation of CommTask */
  CommTaskHandle = osThreadNew(StartCommTask, NULL, &CommTask_attributes);

  /* creation of StorageTask */
  StorageTaskHandle = osThreadNew(StartStorageTask, NULL, &StorageTask_attributes);

  /* creation of EXTITask */
  EXTITaskHandle = osThreadNew(StartEXTITask, NULL, &EXTITask_attributes);

  /* creation of StepperTask */
  StepperTaskHandle = osThreadNew(StartStepperTask, NULL, &StepperTask_attributes);

  /* USER CODE BEGIN RTOS_THREADS */
  configASSERT(MotorTaskHandle != NULL);
  configASSERT(GUITaskHandle != NULL);
  configASSERT(HIDTaskHandle != NULL);
  configASSERT(CommTaskHandle != NULL);
  configASSERT(StorageTaskHandle != NULL);
  configASSERT(EXTITaskHandle != NULL);
  configASSERT(StepperTaskHandle != NULL);
  configASSERT(HIDQHandle != NULL);
  /* add threads, ... */
  /* USER CODE END RTOS_THREADS */

}

void StartMotorTask(void *argument)
{
  /* USER CODE BEGIN StartMotorTask */
  /* Infinite loop */

    MotorFOC_Init();
    MotorFOC_Start();
    Fault_WatchdogStart();
    TickType_t last_wake = xTaskGetTickCount();
   // bool armed = false;

    for (;;)
    {
        Fault_Heartbeat(FAULT_HEALTH_MOTOR);
        Fault_WatchdogPoll();
        (void)Fault_ServiceClearRequest();
        MotorFOC();
        if (MotorFOC_GetState() == MOTOR_FOC_STATE_FAULT)
        {
            Fault_Report(FAULT_BLDC_DRIVER);
        }
        vTaskDelayUntil(&last_wake, pdMS_TO_TICKS(1));
    }
  /* USER CODE END StartMotorTask */
}

void StartGUITask(void *argument)
{
  /* USER CODE BEGIN StartGUITask */
  /* Infinite loop */
	__HAL_TIM_SET_COMPARE(&htim5, TIM_CHANNEL_1, 25);
	 MX_TouchGFX_Process();
  for(;;)
  {
#if ENABLE_DEBUG_TELEMETRY
	  Telemetry_Update();
#endif
    osDelay(20);
  }
  /* USER CODE END StartGUITask */
}

static void hid_tone(uint32_t hz)
{
  if (hz) (void)Buzzer_ToneHz(&g_buzzer, hz, 50u);
  else (void)Buzzer_Stop(&g_buzzer);
}

static void hid_vibration(bool on)
{
  HAL_GPIO_WritePin(VIB_GPIO_Port, VIB_Pin, on ? GPIO_PIN_SET : GPIO_PIN_RESET);
}

void StartHIDTask(void *argument)
{
  /* USER CODE BEGIN StartHIDTask */
  (void)argument;
  /* Operator input is decoded here and consumed by the TouchGFX model
     (ui_input.h). Setpoints, arming and mode changes are owned by the UI. */
  uint32_t previous = __HAL_TIM_GET_COUNTER(&htim3);
  UI_InputInit();
  UI_FeedbackBind(hid_tone, hid_vibration);
  for (;;)
  {
    Fault_Heartbeat(FAULT_HEALTH_HID);
    uint32_t now = HAL_GetTick();
    uint32_t count = __HAL_TIM_GET_COUNTER(&htim3);
    int32_t delta = Operator_EncoderDelta(count, previous, __HAL_TIM_GET_AUTORELOAD(&htim3) + 1u);
    previous = count;
    uint32_t pressed = 0;
    /* Knob, SIDE and BACK are active low; FRW and REV are active high. */
    if (HAL_GPIO_ReadPin(UI_ENC_BUTTON_GPIO_Port, UI_ENC_BUTTON_Pin) == GPIO_PIN_RESET) pressed |= 1u << UI_KEY_KNOB;
    if (HAL_GPIO_ReadPin(SIDE_BUTTON_GPIO_Port, SIDE_BUTTON_Pin) == GPIO_PIN_RESET) pressed |= 1u << UI_KEY_SIDE;
    if (HAL_GPIO_ReadPin(BACK_BUTTON_GPIO_Port, BACK_BUTTON_Pin) == GPIO_PIN_RESET) pressed |= 1u << UI_KEY_BACK;
    if (HAL_GPIO_ReadPin(FRW_BUT_GPIO_Port, FRW_BUT_Pin) == GPIO_PIN_SET) pressed |= 1u << UI_KEY_FRW;
    if (HAL_GPIO_ReadPin(REV_BUT_GPIO_Port, REV_BUT_Pin) == GPIO_PIN_SET) pressed |= 1u << UI_KEY_REV;
    UI_InputPoll(now, delta, pressed);
    UI_PedalSetCounts((int16_t)__HAL_TIM_GET_COUNTER(&htim4));
    UI_FeedbackTick(now);
    osDelay(10);
  }
  /* USER CODE END StartHIDTask */
}

void StartCommTask(void *argument)
{
  for(;;)
  {
    osDelay(1);
  }
}

void StartStorageTask(void *argument)
{
  for(;;)
  {
    osDelay(1);
  }
}

void StartEXTITask(void *argument)
{
  /* USER CODE BEGIN StartEXTITask */

    uint32_t events;

    // per-input debounce timestamps
    TickType_t t_limit = 0, t_fan = 0, t_enc_I = 0;
    const TickType_t db = pdMS_TO_TICKS(20); // 20ms debounce (buttons/switches)

  /* Infinite loop */
  for(;;)
  {
      // wait until ISR notifies us
      xTaskNotifyWait(0, 0xFFFFFFFFu, &events, portMAX_DELAY);

      TickType_t now = xTaskGetTickCount();

      if ((events & EVT_PEDAL_HOME) && (now - t_limit) > db)
      {
          t_limit = now;
          /* Pedal home switch: re-zero the pedal encoder. Not a fault. */
          __HAL_TIM_SET_COUNTER(&htim4, 0);
          UI_PedalMarkHomed();

      }

      /* SIDE, BACK, FRW, REV and the knob button are polled by the HID task
         (debounce + hold timing live in ui_input.c). */

      if ((events & EVT_FAN) && (now - t_fan) > db)
      {
          t_fan = now;
          /* This net is the PWM command; no rotation feedback exists. */
      }

      if ((events & EVT_ENC_I) && (now - t_enc_I) > db)
      {
          t_enc_I = now;
          // Handle encoder index pulse
      }

    osDelay(50);
  }
  /* USER CODE END StartEXTITask */
}

void StartStepperTask(void *argument)
{
  /* USER CODE BEGIN StartStepperTask */
    (void)argument;

    TMC2130_Config_t cfg;
    TMC2130_ConfigDefaults(&cfg);
    cfg.microsteps = 16;
    cfg.interpolate_256 = true;
    cfg.ihold = 8;
    cfg.irun = 16;
    cfg.ihold_delay = 6;

    if (TMC2130_Init(&g_tmc2130, &hspi3, &htim12, TIM_CHANNEL_2, &cfg) != HAL_OK)
    {
        Fault_Report(FAULT_STEPPER_DRIVER | FAULT_SPI);
    }

    TMC2130Motion_Limits_t limits;
    TMC2130Motion_DefaultLimits(&limits);

    if (TMC2130Motion_Init(&g_stepper_motion, &g_tmc2130, &limits) != HAL_OK)
    {
        Fault_Report(FAULT_STEPPER_DRIVER);
    }

    (void)TMC2130Motion_Enable(&g_stepper_motion, false);

	TickType_t last = xTaskGetTickCount();
  /* Infinite loop */
  for(;;)
  {
      static TickType_t previous = 0;
      TickType_t now = xTaskGetTickCount();
      float dt = previous ? (float)(now - previous) / configTICK_RATE_HZ : 0.001f;
      previous = now;
      Fault_Heartbeat(FAULT_HEALTH_STEPPER);
      UI_ProcessStepperCommands();
      static TickType_t status_tick = 0;
      if ((TickType_t)(now - status_tick) >= pdMS_TO_TICKS(50))
      {
          uint32_t status, gstat;
          status_tick = now;
          if (TMC2130_ReadDRVStatus(&g_tmc2130, &status) != HAL_OK ||
              TMC2130_ReadGSTAT(&g_tmc2130, &gstat) != HAL_OK)
              Fault_Report(FAULT_STEPPER_DRIVER | FAULT_SPI);
          else if ((status & ((1u << 25) | (1u << 27) | (1u << 28))) || (gstat & 7u))
              Fault_Report(FAULT_STEPPER_DRIVER); /* overtemperature, short or reset/UV */
      }
      TMC2130Motion_Task(&g_stepper_motion, dt);
      UI_PublishStepperSnapshot();
      vTaskDelayUntil(&last, pdMS_TO_TICKS(1));
  }
  /* USER CODE END StartStepperTask */
}

/* USER CODE BEGIN Application */
void HAL_GPIO_EXTI_Callback(uint16_t GPIO_Pin)
{
    BaseType_t hpw = pdFALSE;
    uint32_t bits = 0;

    if (GPIO_Pin == LIMIT_BUTTON_Pin) bits |= EVT_PEDAL_HOME; /* pedal home switch: zero TIM4 */

    /* Buttons are polled by the HID task; their EXTI edges only wake the MCU. */

    /* FAN_FAULT is actually the MAX31740 PWM output; never report it as a fault. */

    if (GPIO_Pin == I_ENC_Pin) bits |= EVT_ENC_I;

    if (bits && EXTITaskHandle)
    {
        xTaskNotifyFromISR(EXTITaskHandle, bits, eSetBits, &hpw);
        portYIELD_FROM_ISR(hpw);
    }
}
/* USER CODE END Application */
